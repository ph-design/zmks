## app/dts/bindings/zmk,combos.yaml
```yaml
# Copyright (c) 2020, The ZMK Contributors
# SPDX-License-Identifier: MIT

description: Combos container

compatible: "zmk,combos"

child-binding:
  description: "A combo"

  properties:
    bindings:
      type: phandle-array
      required: true
    key-positions:
      type: array
      required: true
    timeout-ms:
      type: int
      default: 50
    require-prior-idle-ms:
      type: int
      default: -1
    slow-release:
      type: boolean
    layers:
      type: array
    reserved:
      type: boolean
      description: |
        Marks this combo slot as reserved for runtime use (e.g. ZMK Studio).
        Reserved slots keep their position in the combos array so that
        ZMK_VIRTUAL_KEY_POSITION_COMBO(index) and downstream virtual key
        positions stay fixed, but are disabled at boot: their key positions
        only serve to size MAX_COMBO_KEYS and are not entered into the combo
        lookup table. A runtime config write (assigning real key positions)
        enables the slot.
```

## app/dts/bindings/zmk,rgb-matrix-transform.yaml
```yaml
description: |
  RGB Matrix Transform node.
  Provides strip-to-binding mapping and optional per-binding physical
  coordinates for coordinate-based RGB effects (QMK-style).

  map[strip_idx] = binding_idx
  led-positions[binding_idx] = (x, y) interleaved

compatible: "zmk,rgb-matrix-transform"

properties:
  map:
    type: array
    required: true
    description: |
      Mapping array: map[strip_idx] = binding_idx.
      Array length must equal the LED strip chain-length.
      Multiple entries may share the same value (multi-LED per key).

  led-positions:
    type: array
    required: false
    description: |
      Physical coordinates (x, y) for each binding, in binding order.
      Array length = num_bindings * 2 (interleaved x, y pairs).
      Units are arbitrary; values are normalised to 0-255 at runtime.
      Required for coordinate-based spatial effects (rainbow wave,
      reactive wide, ripple, heatmap, etc.).
```

## app/dts/bindings/zmk,underglow-layer.yaml
```yaml
description: |
  Allows defining a rgbmap composed of multiple layers

compatible: "zmk,underglow-layer"

properties:
  pixel-lookup:
    type: array
    required: false
    description: |
      Legacy mapping array: pixel-lookup[strip_idx] = binding_idx.
      Deprecated in favour of the 'transform' phandle.
      One of pixel-lookup or transform must be provided.

  transform:
    type: phandle
    required: false
    description: |
      Reference to a zmk,rgb-matrix-transform node that provides
      strip-to-binding mapping (map) and optional per-LED physical
      coordinates (led-positions).  When present, pixel-lookup is
      ignored.

child-binding:
  description: "A layer to be used in a rgbmap"

  properties:
    bindings:
      type: phandle-array
      required: true
    layer-id:
      type: int
      required: true
    fade-delay:
      type: int
      required: false
      default: -1
```

## app/module/drivers/esb/Kconfig
```kconfig
# Copyright (c) 2026 Team PHDesign
# SPDX-License-Identifier: MIT

menuconfig ZMK_ESB
	bool "ZMK ESB Radio Driver"
	depends on SOC_SERIES_NRF52X
	select NRFX_PPI
	select DYNAMIC_INTERRUPTS
	help
	  Enhanced ShockBurst radio driver for nRF52 series.
	  Supports PTX/PRX with ACK payload.

if ZMK_ESB

config ZMK_ESB_MAX_PAYLOAD_LENGTH
	int "Max payload length"
	default 32
	range 1 252

config ZMK_ESB_TX_FIFO_SIZE
	int "TX FIFO size"
	default 8
	range 1 16

config ZMK_ESB_RX_FIFO_SIZE
	int "RX FIFO size"
	default 8
	range 1 16

config ZMK_ESB_PIPE_COUNT
	int "Number of pipes"
	default 8
	range 1 8

config ZMK_ESB_DEFAULT_RF_CHANNEL
	int "Default RF channel"
	default 2
	range 0 100

config ZMK_ESB_LOG_LEVEL
	int "Log level"
	default 3
	range 0 4

endif # ZMK_ESB
```

## app/module/drivers/sensor/lis2de12/Kconfig
```kconfig
# LIS2DE12 Three Axis Accelerometer configuration options

# Copyright (c) 2017 Intel Corporation
# SPDX-License-Identifier: Apache-2.0

menuconfig LIS2DE12
	bool "LIS2DE12 Three Axis Accelerometer"
	default y
	depends on DT_HAS_ST_LIS2DE12_ENABLED
	select I2C if $(dt_compat_on_bus,$(DT_COMPAT_ST_LIS2DE12),i2c)
	select SPI if $(dt_compat_on_bus,$(DT_COMPAT_ST_LIS2DE12),spi)
	help
	  Enable SPI/I2C-based driver for the LIS2DE12 triaxial accelerometer.

if LIS2DE12

choice LIS2DE12_TRIGGER_MODE
	prompt "Trigger mode"
	help
	  Specify the type of triggering to be used by the driver.

config LIS2DE12_TRIGGER_NONE
	bool "No trigger"

config LIS2DE12_TRIGGER_GLOBAL_THREAD
	bool "Use global thread"
	depends on GPIO
	select LIS2DE12_TRIGGER

config LIS2DE12_TRIGGER_OWN_THREAD
	bool "Use own thread"
	depends on GPIO
	select LIS2DE12_TRIGGER

endchoice

config LIS2DE12_TRIGGER
	bool

config LIS2DE12_THREAD_PRIORITY
	int "Thread priority"
	depends on LIS2DE12_TRIGGER_OWN_THREAD
	default 10
	help
	  Priority of thread used by the driver to handle interrupts.

config LIS2DE12_THREAD_STACK_SIZE
	int "Thread stack size"
	depends on LIS2DE12_TRIGGER_OWN_THREAD
	default 1024
	help
	  Stack size of thread used by the driver to handle interrupts.

choice LIS2DE12_ACCEL_RANGE
	prompt "Acceleration measurement range"
	default LIS2DE12_ACCEL_RANGE_RUNTIME
	help
	  Initial measurement full scale range for acceleration values.

config LIS2DE12_ACCEL_RANGE_RUNTIME
	bool "Set at runtime"

config LIS2DE12_ACCEL_RANGE_2G
	bool "+/-2g"

config LIS2DE12_ACCEL_RANGE_4G
	bool "+/-4g"

config LIS2DE12_ACCEL_RANGE_8G
	bool "+/-8g"

config LIS2DE12_ACCEL_RANGE_16G
	bool "+/-16g"

endchoice

config LIS2DE12_OPER_MODE_LOW_POWER
	bool
	default y

choice LIS2DE12_ODR
	prompt "Output data rate frequency"
	default LIS2DE12_ODR_RUNTIME
	help
	  Initial data rate frequency of acceleration data at initialization.
	  Supported values:
	  1Hz, 10Hz, 25Hz, 50Hz, 100Hz, 200Hz, 400Hz in low-power mode
	  1620Hz, 5376Hz in low-power mode only

config LIS2DE12_ODR_RUNTIME
	bool "Set at runtime"

config LIS2DE12_ODR_1
	bool "1Hz"

config LIS2DE12_ODR_2
	bool "10Hz"

config LIS2DE12_ODR_3
	bool "25Hz"

config LIS2DE12_ODR_4
	bool "50Hz"

config LIS2DE12_ODR_5
	bool "100Hz"

config LIS2DE12_ODR_6
	bool "200Hz"

config LIS2DE12_ODR_7
	bool "400Hz"

config LIS2DE12_ODR_8
	bool "1.620KHz"
	depends on LIS2DE12_OPER_MODE_LOW_POWER

config LIS2DE12_ODR_9_LOW
	bool "5.376KHz"
	depends on LIS2DE12_OPER_MODE_LOW_POWER

endchoice

config LIS2DE12_ACCEL_HP_FILTERS
	bool "Set High Pass filters for AOI functions on interrupt lines"

config LIS2DE12_BLOCK_DATA_UPDATE
	bool "Output registers not updated until MSB and LSB read"

config LIS2DE12_MEASURE_TEMPERATURE
	bool "Temperature measurements"
	select LIS2DE12_BLOCK_DATA_UPDATE
	help
	  The temperature sensor is most suitable for measuring
	  relative temperature. For example, it is X degrees C
	  cooler or warmer.
	  Each chip has an offset.  This offset must be applied
	  to the result. The offset can be obtained by comparing
	  the reported temperature to a reference.
	  This option does not apply to the LSM330DLHC.

config LIS2DE12_SELF_TEST
	bool "Self test attribute"
	help
	  Enable support for configuring the sensor self test bits.
	  Refer to the datasheet of the sensor for a description of
	  the appropriate self test procedure.

endif # LIS2DE12
```

## app/module/drivers/sensor/lis2dh/Kconfig
```kconfig
# ZMK_LIS2DH Three Axis Accelerometer configuration options

# Copyright (c) 2017 Intel Corporation
# SPDX-License-Identifier: Apache-2.0

menuconfig ZMK_LIS2DH
	bool "ZMK_LIS2DH Three Axis Accelerometer"
	default y
	depends on DT_HAS_ZMK_LIS2DH_ENABLED
	select I2C if $(dt_compat_on_bus,$(DT_COMPAT_ZMK_LIS2DH),i2c)
	select SPI if $(dt_compat_on_bus,$(DT_COMPAT_ZMK_LIS2DH),spi)
	help
	  Enable SPI/I2C-based driver for ZMK_LIS2DH, LIS3DH, LSM303DLHC,
	  ZMK_LIS2DH12, LSM303AGR triaxial accelerometer sensors.

if ZMK_LIS2DH

choice ZMK_LIS2DH_TRIGGER_MODE
	prompt "Trigger mode"
	help
	  Specify the type of triggering to be used by the driver.

config ZMK_LIS2DH_TRIGGER_NONE
	bool "No trigger"

config ZMK_LIS2DH_TRIGGER_GLOBAL_THREAD
	bool "Use global thread"
	depends on GPIO
	select ZMK_LIS2DH_TRIGGER

config ZMK_LIS2DH_TRIGGER_OWN_THREAD
	bool "Use own thread"
	depends on GPIO
	select ZMK_LIS2DH_TRIGGER

endchoice

config ZMK_LIS2DH_TRIGGER
	bool

config ZMK_LIS2DH_THREAD_PRIORITY
	int "Thread priority"
	depends on ZMK_LIS2DH_TRIGGER_OWN_THREAD
	default 10
	help
	  Priority of thread used by the driver to handle interrupts.

config ZMK_LIS2DH_THREAD_STACK_SIZE
	int "Thread stack size"
	depends on ZMK_LIS2DH_TRIGGER_OWN_THREAD
	default 1024
	help
	  Stack size of thread used by the driver to handle interrupts.

choice ZMK_LIS2DH_ACCEL_RANGE
	prompt "Acceleration measurement range"
	default ZMK_LIS2DH_ACCEL_RANGE_RUNTIME
	help
	  Initial measurement full scale range for acceleration values.

config ZMK_LIS2DH_ACCEL_RANGE_RUNTIME
	bool "Set at runtime"

config ZMK_LIS2DH_ACCEL_RANGE_2G
	bool "+/-2g"

config ZMK_LIS2DH_ACCEL_RANGE_4G
	bool "+/-4g"

config ZMK_LIS2DH_ACCEL_RANGE_8G
	bool "+/-8g"

config ZMK_LIS2DH_ACCEL_RANGE_16G
	bool "+/-16g"

endchoice

choice ZMK_LIS2DH_OPER_MODE
	prompt "Operation mode"
	default ZMK_LIS2DH_OPER_MODE_NORMAL
	help
	  Choose between high resolution, normal or low power operation
	  mode for chip at init.

config ZMK_LIS2DH_OPER_MODE_HIGH_RES
	bool "high resolution (12 bit)"

config ZMK_LIS2DH_OPER_MODE_NORMAL
	bool "normal (10 bit)"

config ZMK_LIS2DH_OPER_MODE_LOW_POWER
	bool "low power (8 bit)"

endchoice

choice ZMK_LIS2DH_ODR
	prompt "Output data rate frequency"
	default ZMK_LIS2DH_ODR_RUNTIME
	help
	  Initial data rate frequency of acceleration data at initialization.
	  Supported values:
	  1Hz, 10Hz, 25Hz, 50Hz, 100Hz, 200Hz, 400Hz in all power modes
	  1620Hz, 5376Hz in low power mode only
	  1344Hz in normal power mode

config ZMK_LIS2DH_ODR_RUNTIME
	bool "Set at runtime"

config ZMK_LIS2DH_ODR_1
	bool "1Hz"

config ZMK_LIS2DH_ODR_2
	bool "10Hz"

config ZMK_LIS2DH_ODR_3
	bool "25Hz"

config ZMK_LIS2DH_ODR_4
	bool "50Hz"

config ZMK_LIS2DH_ODR_5
	bool "100Hz"

config ZMK_LIS2DH_ODR_6
	bool "200Hz"

config ZMK_LIS2DH_ODR_7
	bool "400Hz"

config ZMK_LIS2DH_ODR_8
	bool "1.6KHz"
	depends on ZMK_LIS2DH_OPER_MODE_LOW_POWER

config ZMK_LIS2DH_ODR_9_NORMAL
	bool "1.25KHz"
	depends on ZMK_LIS2DH_OPER_MODE_NORMAL || ZMK_LIS2DH_OPER_MODE_HIGH_RES

config ZMK_LIS2DH_ODR_9_LOW
	bool "5KHz"
	depends on ZMK_LIS2DH_OPER_MODE_LOW_POWER

endchoice

config ZMK_LIS2DH_ACCEL_HP_FILTERS
	bool "Set High Pass filters for AOI functions on interrupt lines"

config ZMK_LIS2DH_BLOCK_DATA_UPDATE
	bool "Output registers not updated until MSB and LSB read"

config ZMK_LIS2DH_MEASURE_TEMPERATURE
	bool "Temperature measurements"
	select ZMK_LIS2DH_BLOCK_DATA_UPDATE
	help
	  The temperature sensor is most suitable for measuring
	  relative temperature. For example, it is X degrees C
	  cooler or warmer.
	  Each chip has an offset.  This offset must be applied
	  to the result. The offset can be obtained by comparing
	  the reported temperature to a reference.
	  This option does not apply to the LSM330DLHC.

config ZMK_LIS2DH_SELF_TEST
	bool "Self test attribute"
	help
	  Enable support for configuring the sensor self test bits.
	  Refer to the datasheet of the sensor for a description of
	  the appropriate self test procedure.

endif # ZMK_LIS2DH
```

## app/module/dts/bindings/sensor/st,lis2de12-i2c.yaml
```yaml
# Copyright (c) 2018 STMicroelectronics
# SPDX-License-Identifier: Apache-2.0

description: |
    STMicroelectronics LIS2DE12 3-axis accelerometer accessed through I2C bus

compatible: "st,lis2de12"

include: ["i2c-device.yaml", "st,lis2de12-common.yaml"]
```

## app/module/dts/bindings/sensor/st,lis2de12-spi.yaml
```yaml
# Copyright (c) 2018 STMicroelectronics
# SPDX-License-Identifier: Apache-2.0

description: |
    STMicroelectronics LIS2DE12 3-axis accelerometer accessed through SPI bus

compatible: "st,lis2de12"

include: ["spi-device.yaml", "st,lis2de12-common.yaml"]
```

## app/module/dts/bindings/sensor/st,lis2dh-i2c.yaml
```yaml
# Copyright (c) 2018 STMicroelectronics
# SPDX-License-Identifier: Apache-2.0

description: |
    STMicroelectronics LIS2DH 3-axis accelerometer accessed through I2C bus

compatible: "zmk,lis2dh"

include: ["i2c-device.yaml", "zmk,lis2dh-common.yaml"]
```

## app/module/dts/bindings/sensor/st,lis2dh-spi.yaml
```yaml
# Copyright (c) 2018 STMicroelectronics
# SPDX-License-Identifier: Apache-2.0

description: |
    STMicroelectronics LIS2DH 3-axis accelerometer accessed through SPI bus

compatible: "zmk,lis2dh"

include: ["spi-device.yaml", "zmk,lis2dh-common.yaml"]
```

## app/west.yml
```yaml
manifest:
  remotes:
    - name: zephyrproject-rtos
      url-base: https://github.com/zephyrproject-rtos
    - name: zmkfirmware
      url-base: https://github.com/zmkfirmware
    - name: ph-design
      url-base: https://github.com/ph-design
  projects:
    - name: zephyr
      remote: zmkfirmware
      revision: v3.5.0+zmk-fixes
      clone-depth: 1
      import:
        name-blocklist:
          - ci-tools
          - hal_altera
          - hal_cypress
          - hal_infineon
          - hal_microchip
          - hal_nxp
          - hal_openisa
          - hal_silabs
          - hal_xtensa
          - hal_st
          - hal_ti
          - loramac-node
          - mcuboot
          - mcumgr
          - net-tools
          - openthread
          - edtt
          - trusted-firmware-m
    - name: nanopb
      revision: 8c60555d6277a0360c876bd85d491fc4fb0cd74a
      path: modules/lib/nanopb
      remote: zmkfirmware
    - name: zmk-studio-messages
      revision: v0.3_lts
      path: modules/msgs/zmk-studio-messages
      remote: ph-design
  self:
    west-commands: scripts/west-commands.yml
```
